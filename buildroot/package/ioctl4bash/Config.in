## buildroot/package/ioctl4bash/Config.in
```kconfig
config BR2_PACKAGE_IOCTL4BASH
    bool "ioctl4bash"
   # depends on BR2_TOOLCHAIN_GCC
    help
      A simple tool to interact with device drivers using ioctl calls.
```
